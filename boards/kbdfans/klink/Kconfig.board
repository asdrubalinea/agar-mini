## boards/kbdfans/klink/Kconfig.board
```kconfig
# Copyright (c) 2020 The ZMK Contributors
# SPDX-License-Identifier: MIT

config BOARD_KLINK
    bool "klink"
    depends on SOC_NRF52840_QIAA
```

## config/boards/shields/klink_kbd/Kconfig.shield
```kconfig
# Copyright (c) 2020 The ZMK Contributors
# SPDX-License-Identifier: MIT

config SHIELD_AGAR_MINI_BLE
    def_bool $(shields_list_contains,agar_mini_ble)
```
