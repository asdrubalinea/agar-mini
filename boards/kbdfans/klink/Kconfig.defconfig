## boards/kbdfans/klink/Kconfig.defconfig
```kconfig
# Copyright (c) 2020 The ZMK Contributors
# SPDX-License-Identifier: MIT

if BOARD_KLINK

if USB_DEVICE_STACK

config USB_NRFX
    default y

endif # USB_DEVICE_STACK

endif # BOARD_KLINK
```

## boards/kbdfans/klink/Kconfig.klink
```kconfig
# Copyright (c) 2020 The ZMK Contributors
# SPDX-License-Identifier: MIT

config BOARD_KLINK
    select SOC_NRF52840_QIAA
    select ZMK_BOARD_COMPAT if BOARD_KLINK_NRF52840_ZMK
    imply RETAINED_MEM if BOARD_KLINK_NRF52840_ZMK
    imply RETENTION if BOARD_KLINK_NRF52840_ZMK
    imply RETENTION_BOOT_MODE if BOARD_KLINK_NRF52840_ZMK
```

## boards/kbdfans/klink/board.yml
```yaml
board:
  name: klink
  vendor: kbdfans
  socs:
    - name: nrf52840
      variants:
        - name: zmk
```

## config/west.yml
```yaml
manifest:
  remotes:
    - name: zmkfirmware
      url-base: https://github.com/zmkfirmware
  projects:
    # Official ZMK. The Agar mini's board and shield live in this repo.
    - name: zmk
      remote: zmkfirmware
      revision: 4dd95d7840eb3d5a3f59bb29fbf1ab054715ef85  # main, 2026-10-09
      import: app/west.yml
    # Pin Zephyr too: ZMK's own manifest names a branch, which can move.
    - name: zephyr
      remote: zmkfirmware
      revision: 10ba6d0cb38bc3d258775d27982f707599320085  # v4.1.0+zmk-fixes
      import:
        name-blocklist:
          - ci-tools
          - hal_altera
          - hal_cypress
          - hal_infineon
          - hal_microchip
          - hal_nxp
          - hal_openisa
          - hal_xtensa
          - hal_st
          - hal_ti
          - loramac-node
          - mcuboot
          - mcumgr
          - net-tools
          - openthread
          - edtt
          - trusted-firmware-m
  self:
    path: config
```
